/* Copyright (c) 2013-2014, The Linux Foundation. All rights reserved.
 *
 * This program is free software; you can redistribute it and/or modify
 * it under the terms of the GNU General Public License version 2 and
 * only version 2 as published by the Free Software Foundation.
 *
 * This program is distributed in the hope that it will be useful,
 * but WITHOUT ANY WARRANTY; without even the implied warranty of
 * MERCHANTABILITY or FITNESS FOR A PARTICULAR PURPOSE.  See the
 * GNU General Public License for more details.
 */

&mdss_mdp {
	dsi_jdi_1080_cmd_17421: qcom,mdss_dsi_jdi_1080p_cmd_17421 {
		qcom,mdss-dsi-panel-name = "jdi 1080p cmd mode 17421 dsi panel";
		qcom,mdss-dsi-panel-controller = <&mdss_dsi0>;
		qcom,mdss-dsi-panel-type = "dsi_cmd_mode";
		qcom,mdss-dsi-panel-destination = "display_1";
		qcom,mdss-dsi-panel-framerate = <60>;
		qcom,mdss-dsi-virtual-channel-id = <0>;
		qcom,mdss-dsi-stream = <0>;
		qcom,mdss-dsi-panel-width = <1080>;
		qcom,mdss-dsi-panel-height = <1920>;
		qcom,mdss-dsi-h-front-porch = <32>;
		qcom,mdss-dsi-h-back-porch = <32>;
		qcom,mdss-dsi-h-pulse-width = <4>;
		qcom,mdss-dsi-h-sync-skew = <0>;
		qcom,mdss-dsi-v-back-porch = <6>;
		qcom,mdss-dsi-v-front-porch = <8>;
		qcom,mdss-dsi-v-pulse-width = <2>;

		qcom,mdss-dsi-h-left-border = <0>;
		qcom,mdss-dsi-h-right-border = <0>;
		qcom,mdss-dsi-v-top-border = <0>;
		qcom,mdss-dsi-v-bottom-border = <0>;
		qcom,mdss-dsi-bpp = <24>;
		qcom,mdss-dsi-underflow-color = <0xff>;
		qcom,mdss-dsi-border-color = <0>;
		qcom,mdss-dsi-on-command = [
			29 01 00 00 00 00 02 00 00 
			29 01 00 00 00 00 04 FF 19 02 01
			29 01 00 00 00 00 02 00 80 
			29 01 00 00 00 00 03 FF 19 02
		29 01 00 00 00 00 02 00 00 
		29 01 00 00 00 00 02 1C 00
		/*29 01 00 00 00 00 02 1C 12*/			
			29 01 00 00 00 00 02 00 83 
			29 01 00 00 00 00 02 F3 CA 
			29 01 00 00 00 00 02 00 90 
			29 01 00 00 00 00 02 C4 00 
			29 01 00 00 00 00 02 00 B4
			29 01 00 00 00 00 02 C0 C0 
			29 01 00 00 00 00 05 2A 00 00 04 37
			29 01 00 00 00 00 05 2B 00 00 07 7F
/*skin1.3 --{*/
/*
		29 01 00 00 00 00 02 00 A0 
		29 01 00 00 00 00 0D D6 00 00 00 00 00 00 00 00 00 00 00 00
		29 01 00 00 00 00 02 00 B0 
		29 01 00 00 00 00 0D D6 4d 4d 86 c0 c0 c0 c0 c0 c0 c0 c0 c0
		29 01 00 00 00 00 02 00 C0 
		29 01 00 00 00 00 0D D6 5a 33 80 80 80 80 80 80 80 80 80 80
		29 01 00 00 00 00 02 00 D0 
		29 01 00 00 00 00 0D D6 40 40 40 40 40 40 40 40 40 40 40 40
*/
/*skin1.3 --}*/

/*skin1.5 --{*/

		29 01 00 00 00 00 02 00 A0 
		29 01 00 00 00 00 0D D6 00 00 00 00 00 00 00 00 00 00 00 00
		29 01 00 00 00 00 02 00 B0 
		29 01 00 00 00 00 0D D6 80 80 a0 c0 c0 c0 c0 c0 c0 c0 c0 c0
		29 01 00 00 00 00 02 00 C0 
		29 01 00 00 00 00 0D D6 6b 55 80 80 80 80 80 80 80 80 80 80
		29 01 00 00 00 00 02 00 D0 
		29 01 00 00 00 00 0D D6 40 40 40 40 40 40 40 40 40 40 40 40

/*skin --}*/

/*skin1.7 --{*/
/*
		29 01 00 00 00 00 02 00 A0 
		29 01 00 00 00 00 0D D6 00 00 00 00 00 00 00 00 00 00 00 00
		29 01 00 00 00 00 02 00 B0 
		29 01 00 00 00 00 0D D6 b3 b3 ba c0 c0 c0 c0 c0 c0 c0 c0 c0
		29 01 00 00 00 00 02 00 C0 
		29 01 00 00 00 00 0D D6 7c 77 80 80 80 80 80 80 80 80 80 80
		29 01 00 00 00 00 02 00 D0 
		29 01 00 00 00 00 0D D6 40 40 40 40 40 40 40 40 40 40 40 40
*/
/*skin --}*/
			//for esd bug 2015/08/24 ---{
			29 01 00 00 00 00 02 00 80 
			29 01 00 00 00 00 03 FF FF FF  
			29 01 00 00 00 00 02 00 00 
			29 01 00 00 00 00 04 FF FF FF FF  //Orise disable
			//for esd bug 2015/08/24 ---}

			29 01 00 00 00 00 02 35 00
			//05 01 00 00 78 00 02 11 00
			05 01 00 00 5A 00 02 11 00
			05 01 00 00 0A 00 02 29 00
			
			//for esd bug 2015/08/24 ---{
			29 01 00 00 00 00 02 00 00 
			29 01 00 00 00 00 03 99 11 11   //command1 mask on  
			//29 01 00 00 00 00 02 00 00 
			//29 01 00 00 00 00 03 99 95 27   //command1 mask off  
			//for esd bug 2015/08/24 ---}
			
			];

		qcom,mdss-dsi-off-command = [
			//for esd bug 2015/08/24 ---{		
				 29 01 00 00 00 00 02 00 00 
				 29 01 00 00 00 00 03 99 95 27   //command1 mask off  
			//for esd bug 2015/08/24 ---}
				 05 01 00 00 02 00 02 28 00
				 05 01 00 00 79 00 02 10 00];
		qcom,mdss-dsi-on-command-state = "dsi_lp_mode";
		qcom,mdss-dsi-off-command-state = "dsi_hs_mode";
		qcom,mdss-dsi-h-sync-pulse = <0>;
		qcom,mdss-dsi-traffic-mode = "burst_mode";
		qcom,mdss-dsi-bllp-eof-power-mode;
		qcom,mdss-dsi-bllp-power-mode;
		qcom,mdss-dsi-lane-0-state;
		qcom,mdss-dsi-lane-1-state;
		qcom,mdss-dsi-lane-2-state;
		qcom,mdss-dsi-lane-3-state;
		qcom,mdss-dsi-te-pin-select = <1>;

		/*add for esd check*/
		qcom,esd-check-enabled;	
		/*qcom,mdss-dsi-panel-status-check-mode = "bta_check";*/		
		qcom,mdss-dsi-panel-status-command = [06 01 00 01 05 00 02 0A 08]; 
		qcom,mdss-dsi-panel-status-command-state ="dsi_hs_mode";//"dsi_lp_mode"; 
		qcom,mdss-dsi-panel-status-check-mode = "reg_read";
		qcom,mdss-dsi-panel-status-value = <0x9c>;
		 
		qcom,mdss-dsi-wr-mem-start = <0x2c>;
		qcom,mdss-dsi-wr-mem-continue = <0x3c>;
		qcom,mdss-dsi-te-dcs-command = <1>;
		qcom,mdss-dsi-te-check-enable;
		qcom,mdss-dsi-te-using-te-pin;		
		qcom,mdss-dsi-panel-timings = [D5 32 22 00 60 64 26 34 29 03 04 00];
		qcom,mdss-dsi-t-clk-post = <0x03>;
		qcom,mdss-dsi-t-clk-pre = <0x28>;
		qcom,mdss-dsi-bl-min-level = <1>;//<70>;//
		qcom,mdss-dsi-bl-max-level = <3685>; //<4095>;//
		qcom,mdss-dsi-dma-trigger = "trigger_sw";
		qcom,mdss-dsi-mdp-trigger = "trigger_te";
		qcom,mdss-mdp-transfer-time-us = <12500>;
		/*jowen.li@swdp.system, 2015/06/27 fix CTS framerate issue ,supply by york.zhang*/
		qcom,mdss-dsi-bl-pmic-control-type = "bl_ctrl_wled";
		/*qcom,mdss-dsi-bl-pmic-control-type = "bl_ctrl_pwm";*/
		qcom,mdss-dsi-reset-sequence = <1 10>, <0 10>, <1 15>;
		qcom,mdss-dsi-lp11-init;
		qcom,mdss-pan-physical-width-dimension = <59>;
		qcom,mdss-pan-physical-height-dimension = <104>;
	};
};
