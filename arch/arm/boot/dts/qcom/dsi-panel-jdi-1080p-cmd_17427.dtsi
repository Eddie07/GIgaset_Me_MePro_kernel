/* Copyright (c) 2013-2014, The Linux Foundation. All rights reserved.
 *
 * This program is free software; you can redistribute it and/or modify
 * it under the terms of the GNU General Public License version 2 and
 * only version 2 as published by the Free Software Foundation.
 *
 * This program is distributed in the hope that it will be useful,
 * but WITHOUT ANY WARRANTY; without even the implied warranty of
 * MERCHANTABILITY or FITNESS FOR A PARTICULAR PURPOSE.  See the
 * GNU General Public License for more details.
 */

&mdss_mdp {
	dsi_jdi_1080_cmd_17427: qcom,mdss_dsi_jdi_1080p_cmd_17427 {
		qcom,mdss-dsi-panel-name = "jdi 1080p cmd mode 17427 dsi panel";
		qcom,mdss-dsi-panel-controller = <&mdss_dsi0>;
		qcom,mdss-dsi-panel-type = "dsi_cmd_mode";
		qcom,mdss-dsi-panel-destination = "display_1";
		qcom,mdss-dsi-panel-framerate = <60>;
		qcom,mdss-dsi-virtual-channel-id = <0>;
		qcom,mdss-dsi-stream = <0>;
		qcom,mdss-dsi-panel-width = <1080>;
		qcom,mdss-dsi-panel-height = <1920>;
		qcom,mdss-dsi-h-front-porch = <128>;
		qcom,mdss-dsi-h-back-porch = <18>;
		qcom,mdss-dsi-h-pulse-width = <10>;
		qcom,mdss-dsi-h-sync-skew = <0>;
		qcom,mdss-dsi-v-back-porch = <1>;
		qcom,mdss-dsi-v-front-porch = <18>;
		qcom,mdss-dsi-v-pulse-width = <2>;

		qcom,mdss-dsi-h-left-border = <0>;
		qcom,mdss-dsi-h-right-border = <0>;
		qcom,mdss-dsi-v-top-border = <0>;
		qcom,mdss-dsi-v-bottom-border = <0>;
		qcom,mdss-dsi-bpp = <24>;
		qcom,mdss-dsi-underflow-color = <0xff>;
		qcom,mdss-dsi-border-color = <0>;
		qcom,mdss-dsi-on-command = [
 //5.5 
			15 01 00 00 00 00 02 ff e0
			15 01 00 00 00 00 02 fb 01
			15 01 00 00 00 00 02 b5 86
			15 01 00 00 00 00 02 b6 77
			15 01 00 00 00 00 02 b8 ad

			15 01 00 00 00 00 02 ff 10
			15 01 00 00 00 00 02 fb 01
			15 01 00 00 00 00 02 bb 10
			29 01 00 00 00 00 02 35 00
		        39 01 00 00 00 00 03 44 05 00 
			05 01 00 00 78 00 02 11 00
			05 01 00 00 2A 00 02 29 00
			];
		qcom,mdss-dsi-off-command = [05 01 00 00 02 00 02 28 00
				 05 01 00 00 79 00 02 10 00];

		qcom,mdss-dsi-on-command-state = "dsi_lp_mode";
		qcom,mdss-dsi-off-command-state = "dsi_hs_mode";
		qcom,mdss-dsi-h-sync-pulse = <0>;
		qcom,mdss-dsi-traffic-mode = "burst_mode";
		/*qcom,mdss-dsi-traffic-mode = "non_burst_sync_event"; 
		qcom,mdss-dsi-traffic-mode = "non_burst_sync_pulse";*/
		qcom,mdss-dsi-bllp-eof-power-mode;
		qcom,mdss-dsi-bllp-power-mode;
		qcom,mdss-dsi-lane-0-state;
		qcom,mdss-dsi-lane-1-state;
		qcom,mdss-dsi-lane-2-state;
		qcom,mdss-dsi-lane-3-state;
		qcom,mdss-dsi-te-pin-select = <1>;
		qcom,mdss-dsi-wr-mem-start = <0x2c>;
		qcom,mdss-dsi-wr-mem-continue = <0x3c>;
		qcom,mdss-dsi-te-dcs-command = <1>;
		qcom,mdss-dsi-te-check-enable; //del by lwj
		qcom,mdss-dsi-te-using-te-pin;	

		qcom,mdss-dsi-panel-timings = [E2 36 24 00 66 68 2A 38 2A 03 04 00];
		qcom,mdss-dsi-t-clk-post = <0x20>;//<0x03>; //<0x02>;
		qcom,mdss-dsi-t-clk-pre = <0x28>;

		/*add for esd check*/
		qcom,mdss-dsi-panel-status-command = [06 01 00 01 05 00 02 0A 08]; 
		qcom,mdss-dsi-panel-status-command-state ="dsi_lp_mode"; 
		qcom,mdss-dsi-panel-status-check-mode = "reg_read";
		qcom,mdss-dsi-panel-status-value = <0x9c>; //<0x1c>; 

		qcom,mdss-dsi-bl-min-level = <1>;
		qcom,mdss-dsi-bl-max-level = <3500>;//<3900>;//<3274>;//<4095>;
		qcom,mdss-dsi-dma-trigger = "trigger_sw";
		qcom,mdss-dsi-mdp-trigger = "trigger_te";
		/*jowen.li@swdp.system, 2015/06/27 fix CTS framerate issue ,supply by york.zhang*/
		qcom,mdss-mdp-transfer-time-us = <12500>; 
		qcom,mdss-dsi-bl-pmic-control-type = "bl_ctrl_wled";
		qcom,mdss-dsi-reset-sequence =<1 11>, <0 11>, <1 11>;
		qcom,mdss-pan-physical-width-dimension = <59>;
		qcom,mdss-pan-physical-height-dimension = <104>;
	};
};
