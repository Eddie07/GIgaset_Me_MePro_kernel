## drivers/input/fingerprint/Kconfig
```kconfig
#
# Tablet driver configuration
#
menuconfig INPUT_FINGERPRINT
	bool "Fingerprint"
	help
	  Say Y here, and a list of supported tablets will be displayed.
	  This option doesn't affect the kernel.

	  If unsure, say Y.

if INPUT_FINGERPRINT

menuconfig INPUT_FPC
	bool "Fingerprintcard senseor"
	help
	  Say Y here if you want to support fpc touch sensor.

	  If unsure, say Y.

if INPUT_FPC
source "drivers/input/fingerprint/fpc/Kconfig"
source "drivers/input/fingerprint/fpc/touch/Kconfig"
endif


menuconfig INPUT_MIY
	bool "microarray fingerprint sensor"
	help
	  Say Y here if you want to support mediatek touch sensor.

	  If unsure, say Y.

if INPUT_MIY
source "drivers/input/fingerprint/microarray/Kconfig"
endif

endif
```

## drivers/input/fingerprint/fpc/Kconfig
```kconfig
#
# Tablet driver configuration
#

config INPUT_FPC102X
	tristate "FingerPrintCard FPC102X support (SPI)"
	depends on SPI
	help
	  Say Y here if you want to support an FPC102X touch sensor.

	  To compile this driver as a module, choose M here: the
	  module will be called acecad.
```

## drivers/input/fingerprint/fpc/touch/Kconfig
```kconfig
#
# Tablet driver configuration
#

config INPUT_FPC102X_TOUCH
	tristate "FingerPrintCard FPC102X support (SPI)"
	depends on SPI
	help
	  Say Y here if you want to support an FPC102X touch sensor.

	  To compile this driver as a module, choose M here: the
	  module will be called acecad.
```

## drivers/input/fingerprint/microarray/Kconfig
```kconfig
#
# Tablet driver configuration
#

config INPUT_MAS
	tristate "microarray fingerprint support (SPI)"
	depends on SPI
	help
	  Say Y here if you want to support an MAS touch sensor.

	  To compile this driver as a module, choose M here: the
	  module will be called acecad.
```

## sound/soc/codecs/tfa9890/Kconfig
```kconfig
config SND_SOC_TFA98XX
 bool "tfa9890"
 default y


config SND_SOC_TFA98XX_DEBUG
 bool "tfa9890 debug"
 default y
```
